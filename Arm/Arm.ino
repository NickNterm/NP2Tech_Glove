#include <VarSpeedServo.h>
#include <nRF24L01.h>
#include <RF24.h>
#include "U8glib.h"
RF24 radio(7, 8); // CE, CSN

U8GLIB_SSD1306_128X64 u8g(U8G_I2C_OPT_NONE);

const unsigned char logo [] PROGMEM = {
  0x00, 0x00, 0x00, 0x00, 0x00, 0x00, 0x00, 0x00, 0x00, 0x00, 0x00, 0x00, 0x00, 0x00, 0x00, 0x00,
  0x00, 0x00, 0x00, 0x00, 0x00, 0x00, 0x00, 0x00, 0x00, 0x00, 0x00, 0x00, 0x00, 0x00, 0x00, 0x00,
  0x00, 0x00, 0x00, 0x00, 0x00, 0x00, 0x00, 0x00, 0x00, 0x00, 0x00, 0x00, 0x00, 0x00, 0x00, 0x00,
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  0x00, 0x00, 0x00, 0x00, 0x00, 0x00, 0x00, 0x00, 0x00, 0x00, 0x00, 0x00, 0x00, 0x00, 0x00, 0x00
};//logo

struct package {
  int servo1 = 90;
  int servo2 = 90;
  int servo3 = 76;
  int servo4 = 140;
};//the package that nRF24L01 send

typedef struct package Package;
Package data;

const int maxmoves = 50;//max num of saved moves(its too much 50 moves but its in user's optoin how many are they going tyo use)

int lastmove = 51;//last move num
int moves[maxmoves][4];//saved data
int state = 0;//single click varible
int RealTime = 0;//real time mode||repeat mode
int okpush = 0;//ok btn varible
int move = 0;//current move varible
int changepush = 0;//double click varible
int Connected = 0;
const int okbtn = 10;
const int changebtn = 2;
const int Led = 4;
long lastsend = 0;
long pushedtime = 0;
long clickt = 0;//seconds

const byte address[][6] = {"AR001", "NP2TE"}; // address

VarSpeedServo head;
VarSpeedServo bottom;
VarSpeedServo Xservo;
VarSpeedServo Yservo; //set servos

void setup() {
  bottom.attach(3);
  Yservo.attach(5);
  Xservo.attach(6);
  head.attach(9); //attach servos

  if ( u8g.getMode() == U8G_MODE_R3G3B2 ) {
    u8g.setColorIndex(255);     // white
  }
  else if ( u8g.getMode() == U8G_MODE_GRAY2BIT ) {
    u8g.setColorIndex(3);         // max intensity
  }
  else if ( u8g.getMode() == U8G_MODE_BW ) {
    u8g.setColorIndex(1);         // pixel on
  }
  else if ( u8g.getMode() == U8G_MODE_HICOLOR ) {
    u8g.setHiColorByRGB(255, 255, 255);
  }

  u8g.firstPage();
  do {
    u8g.drawBitmapP( 0, 0, 16, 64, logo);
  } while ( u8g.nextPage() );

  delay(3000);

  pinMode(Led, OUTPUT);//Status LED
  pinMode(okbtn, INPUT_PULLUP);//Button
  pinMode(changebtn, INPUT_PULLUP);

  radio.begin();
  radio.openWritingPipe(address[1]);    //NP2TE
  radio.openReadingPipe(1, address[0]); //AR001
  radio.setPALevel(RF24_PA_MAX);        //set nRF24L01
  radio.setChannel(115);
  radio.setDataRate(RF24_250KBPS);//nRF24L01 settings
  lastsend = millis() / 1000;//set time
}

void loop() {
  if (radio.available()) {
    radio.read(&data, sizeof(data));
    lastsend = millis() / 1000;
    digitalWrite(Led, HIGH);//turn status LED on
    if (move != lastmove) {
      u8g.firstPage();
      do {
        Print(0, move + 1);
      } while ( u8g.nextPage() );
    } else {
      u8g.firstPage();
      do {
        Print(1, move);
      } while ( u8g.nextPage() );
      lastsend = millis() / 1000; //save the time of the last message
    }
  } else if (!radio.available()) {
    Connected = 0;
    if (millis() - (lastsend * 1000) > 300) {
      digitalWrite(Led, LOW);//turn status LED off
      radio.stopListening();//change mode in nRF24L01 from resiver to transmitter
      const char text[] = "Arm-001";//mode
      radio.write(&text, sizeof(text)); //send the mode again to the hand
      u8g.firstPage();
      do {
        Print(2, 0);
      } while ( u8g.nextPage() );
      RealTime = 0;
      move = 0;
      lastmove = 51;//set all varibles a default state
      radio.startListening();
      for (int x = 0; x <= maxmoves; x++) {
        for (int i = 0; i < 4; i++) {
          moves[x][i] = 0;//get the whole two-dimensional array to zeros
        }
      }
      lastsend = millis() / 1000; //save the time of the last message
    }
  }

  if (RealTime == 0) {
    bottom.write(data.servo1);
    Yservo.write(data.servo2);
    Xservo.write(data.servo3);
    head.write(data.servo4);//in RealTime mode the servo obey the hands directions
  }

  if (digitalRead(changebtn) == LOW) {
    changepush = 1;
  }

  if (digitalRead(changebtn) == HIGH && changepush == 1) {
    changepush = 0;
    if (lastmove != move) {
      lastmove = move;//by changing this varible we actually go in repeat mode
    } else {
      move = 0;
      lastmove = 51;
      RealTime = 0;
      for (int x = 0; x <= maxmoves; x++) {
        for (int i = 0; i < 4; i++) {
          moves[x][i] = 0;
        }
      }
    }
  }

  if (digitalRead(okbtn) == LOW) {
    state = 1;//set state in 1 in order to know when it was pressed while digitalRead is LOW
    if (okpush == 0) {
      pushedtime = millis() / 1000;
      okpush = 1;//the first time set get a time while button is pressed
    }
  }

  if (digitalRead(okbtn) == HIGH && state == 1) {
    state = 0;
    if (okpush != 2) {
      okpush = 0;//if the button isnt pressed
      if (move != lastmove) {
        save(data.servo1, data.servo2, data.servo3, data.servo4);//if user dont double press the button save a position in moves array
      } else {//if user double press the button repeat the process by reading and writing the servos
        RealTime = 1;
        for (int x = 0; x < move; x++) {
          bottom.write(moves[x][0], 30);
          Yservo.write(moves[x][1], 30);
          Xservo.write(moves[x][2], 30);
          head.write(moves[x][3], 30);//write the position in each servo
          u8g.firstPage();
          do {
            Print(3, x + 1);
          } while ( u8g.nextPage() );
          delay(2000);//delay so every servo is in position
        }
      }
    } else {
      okpush = 0;
    }
  }
}

void save(int num1, int num2, int num3, int num4) {
  moves[move][0] = num1;
  moves[move][1] = num2;
  moves[move][2] = num3;
  moves[move][3] = num4;// save every varible in each pos in array
  if (move < lastmove) {
    move++;//go to next position
  }
}

void u8g_prepare(void) {
  u8g.setFont(u8g_font_6x13);
  u8g.setFontRefHeightExtendedText();
  u8g.setDefaultForegroundColor();
  u8g.setFontPosTop();
}

void Print(int num, int pos) {
  u8g_prepare();
  switch (num) {
    case 0: Connected1(pos); break;
    case 1: Connected2(pos); break;
    case 2: Disconnect(); break;
    case 3: Repeat(pos); break;
  }
}

void Connected1(int x) {
  u8g.setPrintPos(0, 0);
  u8g.print("Status: Connected");
  u8g.setPrintPos(0, 12);
  u8g.print("Real Time Mode");
  u8g.setPrintPos(0, 24);
  u8g.print("Position: ");
  u8g.print(x);
  u8g.setPrintPos(0, 36);
  u8g.print("<- Save  || Change ->");
  u8g.setPrintPos(0, 48);
  u8g.print("Position || Mode");
}

void Connected2(int x) {
  u8g.setPrintPos(0, 0);
  u8g.print("Stutus: Connected");
  u8g.setPrintPos(0, 12);
  u8g.print("Repeat Mode");
  u8g.setPrintPos(0, 24);
  u8g.print("Saved moves: ");
  u8g.print(x);
  u8g.setPrintPos(0, 36);
  u8g.print("<- Repeat|| Change ->");
  u8g.setPrintPos(0, 48);
  u8g.print(" Moves   || Mode");
}

void Disconnect() {
  u8g.setPrintPos(0, 0);
  u8g.print("Stutus: Disconnected");
  u8g.setPrintPos(0, 12);
  u8g.print("Turn on the Glove ");
  u8g.setPrintPos(0, 24);
  u8g.print("in order to work");
  u8g.setPrintPos(0, 36);
  u8g.print("properly.");
}

void Repeat(int x) {
  u8g.setPrintPos(0, 0);
  u8g.print("Repeat the moves.");
  u8g.setPrintPos(0, 12);
  u8g.print("Position: ");
  u8g.print(x);
  u8g.setPrintPos(0, 24);
  u8g.print("Please Wait...");
}
